## firmware_nodos_a1_a2/NodoSensoresAn/sdkconfig.defaults
```kconfig
CONFIG_915MHZ=y
CONFIG_USE_TCXO=y
CONFIG_MISO_GPIO=11
CONFIG_SCLK_GPIO=9
CONFIG_MOSI_GPIO=10
CONFIG_NSS_GPIO=8
CONFIG_RST_GPIO=12
CONFIG_BUSY_GPIO=13
```

## nodo_central_gateway/NodoCentral/Kconfig.projbuild
```kconfig
menu "Nodo Sensor"

    menu "Wi-Fi y servidor"
        config NODO_WIFI_SSID
            string "SSID de Wi-Fi"
            default ""

        config NODO_WIFI_PASSWORD
            string "Contrasena de Wi-Fi"
            default ""

        config NODO_API_URL
            string "URL del endpoint de recepcion"
            default "http://192.168.1.100/nodo_sensor/ingest.php"

        config NODO_API_KEY
            string "Clave compartida para la API"
            default "cambie-esta-clave"
    endmenu

endmenu
```
